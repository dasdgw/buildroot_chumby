## configs/chumby_defconfig
```kconfig
BR2_arm=y
BR2_CCACHE=y
BR2_GLOBAL_PATCH_DIR="board/chumby/patches"
BR2_TOOLCHAIN_EXTERNAL=y
BR2_TOOLCHAIN_EXTERNAL_CUSTOM=y
BR2_TOOLCHAIN_EXTERNAL_PATH="/home/dasdgw/chumby/toolchain/arm-buildroot-linux-uclibcgnueabi_sdk-buildroot"
BR2_TOOLCHAIN_EXTERNAL_GCC_9=y
BR2_TOOLCHAIN_EXTERNAL_HEADERS_5_9=y
BR2_TOOLCHAIN_EXTERNAL_LOCALE=y
BR2_TOOLCHAIN_EXTERNAL_CXX=y

# greeting
BR2_TOOLCHAIN_EXTERNAL_GDB_SERVER_COPY=y
BR2_TARGET_GENERIC_ISSUE="Welcome to chumby, build with Buildroot"

# For automatic firmware loading
BR2_ROOTFS_DEVICE_CREATION_DYNAMIC_MDEV=y

BR2_TARGET_GENERIC_ROOT_PASSWD="root"
BR2_SYSTEM_DHCP="eth0"

# kernel
BR2_ROOTFS_POST_IMAGE_SCRIPT="board/freescale/common/mxs/post-image.sh"
BR2_LINUX_KERNEL=y
BR2_LINUX_KERNEL_USE_CUSTOM_CONFIG=y
BR2_LINUX_KERNEL_CUSTOM_CONFIG_FILE="board/chumby/chumby.kernel.config"
BR2_LINUX_KERNEL_XZ=y
BR2_LINUX_KERNEL_DTS_SUPPORT=y
BR2_LINUX_KERNEL_INTREE_DTS_NAME="imx23-chumby"
BR2_LINUX_KERNEL_INSTALL_TARGET=y

# alsa
BR2_PACKAGE_ALSA_UTILS=y
BR2_PACKAGE_ALSA_UTILS_ALSACONF=y
BR2_PACKAGE_ALSA_UTILS_ACONNECT=y
BR2_PACKAGE_ALSA_UTILS_AMIXER=y
BR2_PACKAGE_ALSA_UTILS_APLAY=y
BR2_PACKAGE_ALSA_UTILS_SPEAKER_TEST=y
BR2_PACKAGE_ATEST=y
BR2_PACKAGE_AUMIX=y

# kexec
BR2_PACKAGE_KEXEC=y
BR2_PACKAGE_KEXEC_ZLIB=y

BR2_PACKAGE_TRACE_CMD=y

# directfb
BR2_PACKAGE_DOOM_WAD=y
BR2_PACKAGE_PRBOOM=y
BR2_PACKAGE_QUAKE_PAK=y
BR2_PACKAGE_SDLQUAKE=y
BR2_PACKAGE_DIRECTFB=y
BR2_PACKAGE_DIRECTFB_TESTS=y
BR2_PACKAGE_DIRECTFB_EXAMPLES=y

# framebuffer
BR2_PACKAGE_FB_TEST_APP=y
BR2_PACKAGE_FBDUMP=y
BR2_PACKAGE_FBGRAB=y
BR2_PACKAGE_FBTERM=y
BR2_PACKAGE_FBV=y

# firmware
BR2_PACKAGE_LINUX_FIRMWARE=y
BR2_PACKAGE_LINUX_FIRMWARE_RALINK_RT61=y
BR2_PACKAGE_LINUX_FIRMWARE_RALINK_RT73=y
BR2_PACKAGE_LINUX_FIRMWARE_RALINK_RT2XX=y

# linux keyboard & console tools
BR2_PACKAGE_EVTEST=y
BR2_PACKAGE_KBD=y
BR2_PACKAGE_LINUXCONSOLETOOLS=y
BR2_PACKAGE_LINUXCONSOLETOOLS_JOYSTICK=y

# dropbear neads early entropie
BR2_PACKAGE_RNG_TOOLS=y

# chumby utils
BR2_PACKAGE_CHUMBY_UTILS=y

# python
BR2_PACKAGE_PYTHON3=y
BR2_PACKAGE_PYTHON_PIP=y

# needed for ssh

# device tree tools
BR2_PACKAGE_DTC=y
BR2_PACKAGE_DTC_PROGRAMS=y

# ssh
BR2_PACKAGE_DROPBEAR=y

# uboot
BR2_PACKAGE_KMOD=y
BR2_TARGET_ROOTFS_EXT2=y
BR2_TARGET_ROOTFS_EXT2_4=y
BR2_TARGET_ROOTFS_EXT2_SIZE="200M"
BR2_TARGET_UBOOT=y
BR2_TARGET_UBOOT_BUILD_SYSTEM_KCONFIG=y
BR2_TARGET_UBOOT_CUSTOM_GIT=y
BR2_TARGET_UBOOT_CUSTOM_REPO_URL="https://github.com/dasdgw/u-boot.git"
BR2_TARGET_UBOOT_CUSTOM_REPO_VERSION="ffa82a956d6cbd92d993eb6e0059a38d7dcb83cf"
BR2_TARGET_UBOOT_BOARD_DEFCONFIG="mx23_chumby"
BR2_TARGET_UBOOT_FORMAT_SB=y
BR2_TARGET_UBOOT_FORMAT_SD=y
BR2_PACKAGE_HOST_DOSFSTOOLS=y
BR2_PACKAGE_HOST_GENIMAGE=y
BR2_PACKAGE_HOST_MTOOLS=y
```

## configs/chumby_toolchain_defconfig
```kconfig
BR2_arm=y
BR2_TOOLCHAIN_BUILDROOT_LOCALE=y
BR2_PTHREAD_DEBUG=y
BR2_TOOLCHAIN_BUILDROOT_CXX=y
BR2_PACKAGE_HOST_GDB=y
BR2_PACKAGE_HOST_GDB_TUI=y
BR2_PACKAGE_HOST_GDB_PYTHON3=y
BR2_INIT_NONE=y
BR2_SYSTEM_BIN_SH_NONE=y
# BR2_PACKAGE_BUSYBOX is not set
BR2_PACKAGE_GDB=y
BR2_PACKAGE_NCURSES=y
BR2_PACKAGE_URANDOM_SCRIPTS=y
# BR2_TARGET_ROOTFS_TAR is not set
BR2_PACKAGE_HOST_ENVIRONMENT_SETUP=y
```

## package/chumby/chumby-utils/Config.in
```kconfig
config BR2_PACKAGE_CHUMBY_UTILS
       bool "chumby_utils"
       help
         chumby utils like config_util

	 http://files.chumby.com/source/falconwing/build2370/utils-1.0.tgz
```
